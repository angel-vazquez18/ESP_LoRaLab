## firmware/lora_node/main/Kconfig.projbuild
```kconfig
menu "LoRaLab physical audio configuration"
config LORALAB_AUDIO_PLAYBACK
    bool "Amplifier/speaker connected to the documented board pins"
    default n
    help
        Enable only for a board with the documented MAX98357A wiring.
        This configures a driver, not acoustic or electrical qualification.
config LORALAB_AUDIO_CAPTURE
    bool "Microphone connected to the documented board pins"
    default n
    help
        INMP441 L/R must be grounded, selecting the left slot.
endmenu

menu "LoRaLab radio board selection"
choice LORALAB_RADIO_BOARD
    prompt "Verified schematic variant (not detected automatically)"
    default LORALAB_RADIO_UNSELECTED
config LORALAB_RADIO_UNSELECTED
    bool "Unselected: leave RF pins untouched"
config LORALAB_RADIO_HELTEC_V42
    bool "Standard Heltec V4.2 with GC1109 front end"
config LORALAB_RADIO_HELTEC_V43
    bool "Standard Heltec V4.3 R2 with KCT8103L front end"
endchoice
endmenu

menu "LoRaLab speech codec dependency"
config LORALAB_CODEC2
    bool "Probe the pinned Codec 2 mode 3200 dependency at startup"
    default y
    help
        Queries real frame dimensions once; encode/decode operations are separate.
endmenu

menu "LoRaLab optional local controls"
config LORALAB_PTT
    bool "Board revision and GPIO47 PTT-to-GND wiring verified"
    depends on LORALAB_AUDIO_CAPTURE
    default n
    help
        Configures only GPIO47 as input with pull-up. The host must arm one
        fixed-length capture, then a fresh debounced release/press starts it.
        No button action or transmission resumes after stop or ownership loss.
endmenu

menu "LoRaLab optional OLED status"
config LORALAB_OLED
    bool "Standard V4 R2 OLED pins and Vext power control verified"
    depends on LORALAB_RADIO_HELTEC_V42 || LORALAB_RADIO_HELTEC_V43
    default n
    help
        SSD1315 128x64 at address 0x3c. Uses SDA17/SCL18, reset21 and
        GPIO36 low to enable Vext. Verify the actual standard PCB first;
        V4-R8 is unsupported. Updates use an isolated bounded I2C worker.
endmenu
```
